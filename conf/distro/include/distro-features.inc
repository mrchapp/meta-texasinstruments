## conf/distro/include/versions-23.17.inc
```bitbake
# tasks and images
PREFERRED_VERSION_task-omap-bridge.bb =			"1.0"
PREFERRED_VERSION_task-omap-connectivity.bb =		"1.0"
PREFERRED_VERSION_task-omap-gfx.bb =			"1.0"
PREFERRED_VERSION_task-omap-gst.bb =			"1.0"
PREFERRED_VERSION_task-omap-omx.bb =			"1.0"
PREFERRED_VERSION_task-omap-sn.bb =			"1.0"
PREFERRED_VERSION_task-omap-test.bb =			"1.0"
PREFERRED_VERSION_omap-image-minimal-mtdutils.bb =	"1.0"
PREFERRED_VERSION_omap-image-minimal.bb =		"1.0"
PREFERRED_VERSION_omap-image-mm.bb =			"1.0"
PREFERRED_VERSION_omap-image-sato.bb =			"1.0

# baseport
PREFERRED_VERSION_x-load =		"4.62"
PREFERRED_VERSION_u-boot =		"5.10"
PREFERRED_VERSION_linux-tiomap =	"2.6.24.7-5.25-P1"

# bridge and friends
PREFERRED_VERSION_tidspbridge-module =		"23.17-P1"
PREFERRED_VERSION_tidspbridge-lib =		"23.17-P1"
PREFERRED_VERSION_tidspbridge-samples =		"4.54"
PREFERRED_VERSION_tidspbridge-extra =		"23.13"
PREFERRED_VERSION_tidspbridge-cgt6x =		"6.0.7"
PREFERRED_VERSION_tidspbridge-bios =		"5.33.02"
PREFERRED_VERSION_tidspbridge-dllcreate-native =	"23.11"

# baseimage
PREFERRED_VERSION_baseimage-masterconfig =		"23.x"
PREFERRED_VERSION_baseimage-samplerateconverter =       "1.2-P2"
PREFERRED_VERSION_baseimage-dasf =                      "1.2-P2"
PREFERRED_VERSION_baseimage-hal =                       "1.2-P2"
PREFERRED_VERSION_baseimage-tmon =                      "1.2-P2"
PREFERRED_VERSION_baseimage =                           "1.2-P2"
PREFERRED_VERSION_baseimage-utils =                     "1.2-P2"
PREFERRED_VERSION_baseimage-make-system =               "1.2-P2"
PREFERRED_VERSION_baseimage-avsync =                    "1.2-P2"
PREFERRED_VERSION_baseimage-inst2 =                     "1.2-P2"
PREFERRED_VERSION_baseimage-dasf-cspec =		"1.2-P2"
PREFERRED_VERSION_baseimage-system-cspec =		"1.2-P2"
PREFERRED_VERSION_baseimage-vgpop =			"3.2"

# socket nodes and codecs
PREFERRED_VERSION_tisocketnode-algo =			"3.2"
PREFERRED_VERSION_tisocketnode-dfgm =			"3.2"
PREFERRED_VERSION_tisocketnode-usn =			"3.2"
PREFERRED_VERSION_tisocketnode-control-task =		"3.40"
PREFERRED_VERSION_tisocketnode-vpp =			"3.2"
PREFERRED_VERSION_tisocketnode-ringio =			"3.2"
PREFERRED_VERSION_tisocketnode-ipp =                    "3.2"
#
PREFERRED_VERSION_tisocketnode-mp3 =                    "3.2"
PREFERRED_VERSION_tisocketnode-mp3-codec =              "3.2"
PREFERRED_VERSION_tisocketnode-mpeg4aacdec =            "3.2"
PREFERRED_VERSION_tisocketnode-mpeg4aacdec-codec =      "3.2"
PREFERRED_VERSION_tisocketnode-mpeg4aacenc =            "3.2"
PREFERRED_VERSION_tisocketnode-mpeg4aacenc-codec =      "3.2"
PREFERRED_VERSION_tisocketnode-wma9 =                   "3.2"
PREFERRED_VERSION_tisocketnode-wma9-codec =             "3.2"
PREFERRED_VERSION_tisocketnode-pcmdec =                 "3.1"
PREFERRED_VERSION_tisocketnode-pcmenc =                 "3.2"
PREFERRED_VERSION_tisocketnode-ima-adpcmdec =           "3.2"
PREFERRED_VERSION_tisocketnode-ima-adpcmdec-codec =     "3.2"
PREFERRED_VERSION_tisocketnode-ima-adpcmenc =           "3.2"
PREFERRED_VERSION_tisocketnode-ima-adpcmenc-codec =     "3.2"
PREFERRED_VERSION_tisocketnode-nbamrdec =               "3.2"
PREFERRED_VERSION_tisocketnode-nbamrdec-codec =         "3.2"
PREFERRED_VERSION_tisocketnode-nbamrenc =               "3.2"
PREFERRED_VERSION_tisocketnode-nbamrenc-codec =         "3.2"
PREFERRED_VERSION_tisocketnode-wbamrdec =               "3.2"
PREFERRED_VERSION_tisocketnode-wbamrdec-codec =         "3.2"
PREFERRED_VERSION_tisocketnode-wbamrenc =               "3.2"
PREFERRED_VERSION_tisocketnode-wbamrenc-codec =         "3.2"
PREFERRED_VERSION_tisocketnode-gsmfrdec =               "3.2"
PREFERRED_VERSION_tisocketnode-gsmfrdec-codec =         "3.2"
PREFERRED_VERSION_tisocketnode-gsmfrenc =               "3.2"
PREFERRED_VERSION_tisocketnode-gsmfrenc-codec =         "3.2"
PREFERRED_VERSION_tisocketnode-gsmhrdec =               "3.2"
PREFERRED_VERSION_tisocketnode-gsmhrdec-codec =         "3.2"
PREFERRED_VERSION_tisocketnode-gsmhrenc =               "3.2"
PREFERRED_VERSION_tisocketnode-gsmhrenc-codec =         "3.2"
PREFERRED_VERSION_tisocketnode-g711dec =		"3.2"
PREFERRED_VERSION_tisocketnode-g711dec-codec =		"3.2"
PREFERRED_VERSION_tisocketnode-nmu-plc-vad =            "3.2"
PREFERRED_VERSION_tisocketnode-g711enc =		"3.2"
PREFERRED_VERSION_tisocketnode-g711enc-codec =		"3.2"
PREFERRED_VERSION_tisocketnode-g722dec =		"3.2"
PREFERRED_VERSION_tisocketnode-g722dec-codec =		"3.2"
PREFERRED_VERSION_tisocketnode-g722enc =		"3.2"
PREFERRED_VERSION_tisocketnode-g722enc-codec =		"3.2"
PREFERRED_VERSION_tisocketnode-g723dec =		"3.2"
PREFERRED_VERSION_tisocketnode-g723dec-codec =		"3.2"
PREFERRED_VERSION_tisocketnode-g723enc =		"3.2"
PREFERRED_VERSION_tisocketnode-g723enc-codec =		"3.2"
PREFERRED_VERSION_tisocketnode-g726dec =		"3.2"
PREFERRED_VERSION_tisocketnode-g726dec-codec =		"3.2"
PREFERRED_VERSION_tisocketnode-g726enc =		"3.2"
PREFERRED_VERSION_tisocketnode-g726enc-codec =		"3.2"
PREFERRED_VERSION_tisocketnode-g729dec =		"3.2"
PREFERRED_VERSION_tisocketnode-g729dec-codec =		"3.2"
PREFERRED_VERSION_tisocketnode-g729enc =		"3.2"
PREFERRED_VERSION_tisocketnode-g729enc-codec =		"3.2"
PREFERRED_VERSION_tisocketnode-ilbcdec =		"3.2"
PREFERRED_VERSION_tisocketnode-ilbcdec-codec =		"3.2"
PREFERRED_VERSION_tisocketnode-ilbcenc =		"3.2"
PREFERRED_VERSION_tisocketnode-ilbcenc-codec =		"3.2"
#
PREFERRED_VERSION_tisocketnode-h264dec =                "3.2"
PREFERRED_VERSION_tisocketnode-h264dec-codec =          "3.2"
PREFERRED_VERSION_tisocketnode-h264enc =                "3.2"
PREFERRED_VERSION_tisocketnode-h264enc-codec =          "3.2"
PREFERRED_VERSION_tisocketnode-mpeg4dec =               "3.2"
PREFERRED_VERSION_tisocketnode-mpeg4dec-codec =         "3.2P1"
PREFERRED_VERSION_tisocketnode-mpeg4enc =               "3.2"
PREFERRED_VERSION_tisocketnode-mpeg4enc-codec =         "3.2"
PREFERRED_VERSION_tisocketnode-mpeg4-720pdec =          "3.2"
PREFERRED_VERSION_tisocketnode-mpeg4-720pdec-codec =    "3.2"
PREFERRED_VERSION_tisocketnode-mpeg4-720penc =          "3.2"
PREFERRED_VERSION_tisocketnode-mpeg4-720penc-codec =    "3.2"
PREFERRED_VERSION_tisocketnode-mpeg4-xdm720pdec =          "3.2"
PREFERRED_VERSION_tisocketnode-mpeg4-xdm720pdec-codec =    "3.2"
PREFERRED_VERSION_tisocketnode-mpeg4-xdm720penc =          "3.2"
PREFERRED_VERSION_tisocketnode-mpeg4-xdm720penc-codec =    "3.2"
PREFERRED_VERSION_tisocketnode-mpeg2 =                  "3.2"
PREFERRED_VERSION_tisocketnode-mpeg2-codec =            "3.2"
PREFERRED_VERSION_tisocketnode-wmv9 =                   "3.2"
PREFERRED_VERSION_tisocketnode-wmv9-codec =             "3.2"
PREFERRED_VERSION_tisocketnode-mpeg2 =                  "3.2"
PREFERRED_VERSION_tisocketnode-mpeg2-codec =            "3.2"
PREFERRED_VERSION_tisocketnode-spark =                  "3.2"
PREFERRED_VERSION_tisocketnode-spark-codec =            "3.2"
#
PREFERRED_VERSION_tisocketnode-jpegdec =                "3.2"
PREFERRED_VERSION_tisocketnode-jpegdec-codec =          "3.2"
PREFERRED_VERSION_tisocketnode-jpegenc =                "3.2"
PREFERRED_VERSION_tisocketnode-jpegenc-codec =          "3.2"
PREFERRED_VERSION_tisocketnode-conversions =		"3.2"
#

# openmax
#require versions-tiopenmax-23.17.inc
require versions-tiopenmax-24.0.10.inc


# gstreamer
PREFERRED_VERSION_libgoo =		"git"
PREFERRED_VERSION_gst-goo =		"git"
PREFERRED_VERSION_gst-pyapps =		"5.17"

# connectivity
PREFERRED_VERSION_wilink = 		"23-17"
PREFERRED_VERSION_btfm = 		"23.17.0"
PREFERRED_VERSION_fmapp = 		"23.17.0"
PREFERRED_VERSION_gps-navilink =	"23.17.0"

# graphics
PREFERRED_VERSION_sgx-kernel-module =	"1.3.2.5"
PREFFERED_VERSION_sgx-lib-noxws =	"1.3.2.5"

# open source dependencies
PREFERRED_VERSION_gst-plugins-bad =	"git"
PREFERRED_VERSION_gst-plugins-ugly =	"git"
PREFERRED_VERSION_gst-plugins-good =	"git"
PREFERRED_VERSION_gst-plugins-base =	"git"
PREFERRED_VERSION_gstreamer = 		"git"
PREFERRED_VERSION_gst-qtmux =		"svn"
PREFERRED_VERSION_check =		"0.9.5"
PREFERRED_VERSION_amrnb =		"7.0.0.2"
PREFERRED_VERSION_amrwb =		"7.0.0.1"
#PREFERRED_VERSION_openobex =		"0.22"
PREFERRED_VERSION_bison-1.875 =		"1.875"
PREFERRED_VERSION_bison-native-1.875 =	"1.875"
PREFERRED_VERSION_flex =		"2.5.35"
PREFERRED_VERSION_flex-native =		"2.5.35"
PREFERRED_VERSION_iperf =		"2.0.4"
PREFERRED_VERSION_libmms =		"0.3"

# toolchain
PREFERRED_VERSION_external-csl-toolchain =	"2008q3-72"

# test
PREFERRED_VERSION_cheese	=	"2.24.3"
PREFERRED_VERSION_intltool	=	"0.40.0"

# extra (will be replaced by pokyomap in subsequent releases)
PREFERRED_VERSION_gtk+		=	"2.14.7"
PREFERRED_VERSION_glib-2.0	=	"2.18.4"
PREFERRED_VERSION_pango		=	"1.22.4"
PREFERRED_VERSION_cairo		=	"1.8.6"
PREFERRED_VERSION_pixman	=	"0.14.0"
```
