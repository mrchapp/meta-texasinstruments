## conf/distro/include/versions-tiopenmax-23.17.inc
```bitbake
# openmax
PREFERRED_PROVIDER_virtual/openmax-il =		"meta-tiopenmax-modular"
#PREFERRED_PROVIDER_virtual/openmax-il =		"tiopenmax"
PREFERRED_VERSION_tiopenmax =			"3.23"
PREFERRED_VERSION_tiopenmax-core =		"3.23"
PREFERRED_VERSION_tiopenmax-osal =		"3.23"
PREFERRED_VERSION_tiopenmax-base =		"3.23"
PREFERRED_VERSION_tiopenmax-lcml =		"3.23"
PREFERRED_VERSION_tiopenmax-audiodecode =	"3.23"
PREFERRED_VERSION_tiopenmax-clock =		"3.23"
PREFERRED_VERSION_tiopenmax-perf =		"3.23"
PREFERRED_VERSION_tiopenmax-policymanager =	"3.23"
PREFERRED_VERSION_tiopenmax-audiomanager =	"3.23"
PREFERRED_VERSION_tiopenmax-resourcemanager =	"3.23"
PREFERRED_VERSION_tiopenmax-jpegdec =		"3.23"
PREFERRED_VERSION_tiopenmax-jpegenc =		"3.23"
PREFERRED_VERSION_tiopenmax-aacenc =            "3.23"
PREFERRED_VERSION_tiopenmax-audiodecode =       "3.23"
PREFERRED_VERSION_tiopenmax-armaacdec =         "3.23"
PREFERRED_VERSION_tiopenmax-armaacenc =         "3.23"
PREFERRED_VERSION_tiopenmax-camera =            "3.23"
PREFERRED_VERSION_tiopenmax-common =            "3.23"
PREFERRED_VERSION_tiopenmax-g711dec =           "3.23"
PREFERRED_VERSION_tiopenmax-g711enc =           "3.23"
PREFERRED_VERSION_tiopenmax-g722dec =           "3.23"
PREFERRED_VERSION_tiopenmax-g722enc =           "3.23"
PREFERRED_VERSION_tiopenmax-g723dec =           "3.23"
PREFERRED_VERSION_tiopenmax-g723enc =           "3.23"
PREFERRED_VERSION_tiopenmax-g726dec =           "3.23"
PREFERRED_VERSION_tiopenmax-g726enc =           "3.23"
PREFERRED_VERSION_tiopenmax-g729dec =           "3.23"
PREFERRED_VERSION_tiopenmax-g729enc =           "3.23"
PREFERRED_VERSION_tiopenmax-gsmfrdec =          "3.23"
PREFERRED_VERSION_tiopenmax-gsmfrenc =          "3.23"
PREFERRED_VERSION_tiopenmax-gsmhrdec =          "3.23"
PREFERRED_VERSION_tiopenmax-gsmhrenc =          "3.23"
PREFERRED_VERSION_tiopenmax-ilbcdec =           "3.23"
PREFERRED_VERSION_tiopenmax-ilbcenc =           "3.23"
PREFERRED_VERSION_tiopenmax-imaadpcmdec =       "3.23"
PREFERRED_VERSION_tiopenmax-imaadpcmenc =       "3.23"
PREFERRED_VERSION_tiopenmax-inst2 =		"3.23"
PREFERRED_VERSION_tiopenmax-nbamrdec =          "3.23"
PREFERRED_VERSION_tiopenmax-nbamrenc =          "3.23"
PREFERRED_VERSION_tiopenmax-pcmdec =            "3.23"
PREFERRED_VERSION_tiopenmax-pcmenc =            "3.23"
PREFERRED_VERSION_tiopenmax-postproc =          "3.23"
PREFERRED_VERSION_tiopenmax-prepostproc =	"3.23"
PREFERRED_VERSION_tiopenmax-ram =               "3.23"
PREFERRED_VERSION_tiopenmax-resourcemanager =   "3.23"
PREFERRED_VERSION_tiopenmax-rmproxy =           "3.23"
PREFERRED_VERSION_tiopenmax-videodec =          "3.23"
PREFERRED_VERSION_tiopenmax-videoenc =          "3.23"
PREFERRED_VERSION_tiopenmax-wbamrdec =          "3.23"
PREFERRED_VERSION_tiopenmax-wbamrenc =          "3.23"
PREFERRED_VERSION_tiopenmax-wmadec =            "3.23"
PREFERRED_VERSION_tiopenmax-cspec = 		"3.23"
PREFERRED_VERSION_tiopenmax-avrecordtest =	"3.23"
PREFERRED_VERSION_tiopenmax-avplaytest =	"3.23"
PREFERRED_VERSION_tiopenmax-imagecapturetest =	"3.23"
PREFERRED_VERSION_tiopenmax-imagedisplaytest =	"3.23"
PREFERRED_VERSION_tiopenmax-videodisplaytest =	"3.23"
PREFERRED_VERSION_tiopenmax-videocapturetest =	"3.23"
PREFERRED_VERSION_mm-isp =			"1.15"
```

## conf/distro/include/versions-tiopenmax-24.0.10.inc
```bitbake
# openmax
PREFERRED_PROVIDER_virtual/openmax-il =		"meta-tiopenmax-24-modular"
PREFERRED_VERSION_tiopenmax-core =		"24.0.10"
PREFERRED_VERSION_tiopenmax-osal =		"24.0.10"
PREFERRED_VERSION_tiopenmax-base =		"24.0.10"
PREFERRED_VERSION_tiopenmax-lcml =		"23.5.0.10"
PREFERRED_VERSION_tiopenmax-audiodecode =	"24.0.10"
PREFERRED_VERSION_tiopenmax-audiodecode =       "24.0.10"
PREFERRED_VERSION_tiopenmax-common =            "23.5.0.10"
PREFERRED_VERSION_tiopenmax-rmproxy =           "23.5.0.10"
PREFERRED_VERSION_tiopenmax-videodec =          "23.5.0.10"
PREFERRED_VERSION_tiopenmax-videoenc =          "23.5.0.10"
```

## conf/machine/omap-4430sdp.conf
```bitbake
#@TYPE: Machine
#@NAME: TI OMAP 4430 SDP
#@DESCRIPTION: Machine configuration for the TI OMAP 4430 SDP CHIRON
TARGET_ARCH = "arm"
PACKAGE_EXTRA_ARCHS = "armv4 armv4t armv5te armv6 armv7a"

PREFERRED_PROVIDER_virtual/kernel = "linux-tiomap"

PREFERRED_PROVIDER_virtual/xserver = "xserver-xf86-lite"
XSERVER = "xserver-xf86-lite \
	   xf86-input-evdev \
	   xf86-input-tslib \
	   xf86-input-mouse \
	   xf86-input-keyboard \
	   xf86-video-fbdev \
	   xf86-video-omapfb"

MACHINE_FEATURES = "kernel26 apm alsa usbgadget usbhost screen touchscreen"
KERNEL_IMAGETYPE = "uImage"
IMAGE_FSTYPES ?= "tar.gz jffs2 ext2"
EXTRA_IMAGECMD_jffs2 = "--pad --little-endian --eraseblock=0x20000 -n"
SERIAL_CONSOLE = "-L 115200 ttyS2"
MACHINE_ESSENTIAL_EXTRA_RRECOMMENDS = "u-boot x-load kernel-modules"

# do not put kernel image in Root FS
RDEPENDS_kernel-base = ""

require conf/machine/include/tune-cortexa8.inc
#require conf/machine/include/tune-arm1136jf-s.inc
```

## conf/machine/zoom3.conf
```bitbake
#@TYPE: Machine
#@NAME: Logic PD Zoom3
#@DESCRIPTION: Machine configuration for the OMAP3-powered Logic PD Zoom3 3630
TARGET_ARCH = "arm"
PACKAGE_EXTRA_ARCHS = "armv4 armv4t armv5te armv6 armv7a"

PREFERRED_PROVIDER_virtual/kernel = "linux-tiomap"

MACHINE_FEATURES = "kernel26 apm alsa usbgadget usbhost screen touchscreen"

KERNEL_IMAGETYPE = "uImage"
IMAGE_FSTYPES ?= "tar.gz jffs2 ext2"
UBOOT_ENTRYPOINT ="0x80008000"
UBOOT_LOADADDRESS ="0x80008000"

EXTRA_IMAGECMD_jffs2 = " --pagesize=2048 --eraseblock=131072 -n"
SERIAL_CONSOLE = "-L 115200 ttyS0"
MACHINE_ESSENTIAL_EXTRA_RRECOMMENDS = "u-boot x-load kernel-modules"

require conf/machine/include/tune-cortexa8.inc
```
