## conf/distro/include/versions-23.I3.4.inc
```bitbake
# Versions common to all machines

# tasks and images
PREFERRED_VERSION_task-omap-bridge.bb =			"1.0"
PREFERRED_VERSION_task-omap-connectivity.bb =		"1.0"
PREFERRED_VERSION_task-omap-gfx.bb =			"1.0"
PREFERRED_VERSION_task-omap-gst.bb =			"1.0"
PREFERRED_VERSION_task-omap-omx.bb =			"1.0"
PREFERRED_VERSION_task-omap-sn.bb =			"1.0"
PREFERRED_VERSION_task-omap-test.bb =			"1.0"
PREFERRED_VERSION_omap-image-minimal-mtdutils.bb =	"1.0"
PREFERRED_VERSION_omap-image-minimal.bb =		"1.0"
PREFERRED_VERSION_omap-image-mm.bb =			"1.0"
PREFERRED_VERSION_omap-image-sato.bb =			"1.0

# u-boot & x-loader for zoom2 - zoom3 - omap3630sdp
SRCREV_pn-x-load ?= "251d92815500143aefdbe3b3558a0ce6daeaebdc"
SRCREV_pn-u-boot ?= "373704d054c67bbd48b28d7149e0482f57db4a68"

# Linux TIOMAP kernel for zoom2 - zoom3 - omap3630sdp
SRCREV_pn-linux-tiomap ?= "a3d76157ec14736101217eb864ea6f6aa2fef9e0"

# bridge and friends
SRCREV_pn-tidspbridge-lib = "85d2b37bb6a7150ba8a642a47a97957a3c411f84"
SRCREV_pn-tidspbridge-mpusamples = "85d2b37bb6a7150ba8a642a47a97957a3c411f84"
PREFERRED_VERSION_tidspbridge-samples-dsp =		"4.56"
PREFERRED_VERSION_tidspbridge-extra =		"23.13"
PREFERRED_VERSION_tidspbridge-cgt6x =		"6.0.7"
PREFERRED_VERSION_tidspbridge-bios =		"5.33.04"
PREFERRED_VERSION_tidspbridge-dllcreate-native =	"1.72"

# baseimage
PREFERRED_VERSION_baseimage-masterconfig =		"23.x"
PREFERRED_VERSION_baseimage-samplerateconverter =       "1.9-P1"
PREFERRED_VERSION_baseimage-dasf =                      "1.9-P1"
PREFERRED_VERSION_baseimage-hal =                       "1.9-P1"
PREFERRED_VERSION_baseimage-tmon =                      "1.9-P1"
PREFERRED_VERSION_baseimage =                           "1.9-P1"
PREFERRED_VERSION_baseimage-utils =                     "1.9-P1"
PREFERRED_VERSION_baseimage-make-system =               "1.9-P1"
PREFERRED_VERSION_baseimage-avsync =                    "1.9-P1"
PREFERRED_VERSION_baseimage-inst2 =                     "1.9-P1"
PREFERRED_VERSION_baseimage-dasf-system-cspec =		"1.9-P1"
PREFERRED_VERSION_baseimage-vgpop =			"3.10"

# socket nodes and codecs
PREFERRED_VERSION_tisocketnode-algo =			"3.10-P1"
PREFERRED_VERSION_tisocketnode-dfgm =			"3.10"
PREFERRED_VERSION_tisocketnode-usn =			"3.10"
PREFERRED_VERSION_tisocketnode-control-task =		"3.40"
PREFERRED_VERSION_tisocketnode-vpp =			"3.10"
PREFERRED_VERSION_tisocketnode-ringio =			"3.10"
PREFERRED_VERSION_tisocketnode-ipp =                    "3.10"
#
PREFERRED_VERSION_tisocketnode-mp3 =                    "3.10"
PREFERRED_VERSION_tisocketnode-mp3-codec =              "3.10"
PREFERRED_VERSION_tisocketnode-mpeg4aacdec =            "3.10"
PREFERRED_VERSION_tisocketnode-mpeg4aacdec-codec =      "3.10"
PREFERRED_VERSION_tisocketnode-mpeg4aacenc =            "3.10"
PREFERRED_VERSION_tisocketnode-mpeg4aacenc-codec =      "3.10"
PREFERRED_VERSION_tisocketnode-wma9 =                   "3.10"
PREFERRED_VERSION_tisocketnode-wma9-codec =             "3.10"
PREFERRED_VERSION_tisocketnode-pcmdec =                 "3.10"
PREFERRED_VERSION_tisocketnode-pcmenc =                 "3.10"
PREFERRED_VERSION_tisocketnode-ima-adpcmdec =           "3.10"
PREFERRED_VERSION_tisocketnode-ima-adpcmdec-codec =     "3.10"
PREFERRED_VERSION_tisocketnode-ima-adpcmenc =           "3.10"
PREFERRED_VERSION_tisocketnode-ima-adpcmenc-codec =     "3.10"
PREFERRED_VERSION_tisocketnode-nbamrdec =               "3.10"
PREFERRED_VERSION_tisocketnode-nbamrdec-codec =         "3.10"
PREFERRED_VERSION_tisocketnode-nbamrenc =               "3.10"
PREFERRED_VERSION_tisocketnode-nbamrenc-codec =         "3.10"
PREFERRED_VERSION_tisocketnode-wbamrdec =               "3.10"
PREFERRED_VERSION_tisocketnode-wbamrdec-codec =         "3.10"
PREFERRED_VERSION_tisocketnode-wbamrenc =               "3.10"
PREFERRED_VERSION_tisocketnode-wbamrenc-codec =         "3.10"
PREFERRED_VERSION_tisocketnode-gsmfrdec =               "3.10"
PREFERRED_VERSION_tisocketnode-gsmfrdec-codec =         "3.10"
PREFERRED_VERSION_tisocketnode-gsmfrenc =               "3.10-P1"
PREFERRED_VERSION_tisocketnode-gsmfrenc-codec =         "3.10"
PREFERRED_VERSION_tisocketnode-gsmhrdec =               "3.10"
PREFERRED_VERSION_tisocketnode-gsmhrdec-codec =         "3.10"
PREFERRED_VERSION_tisocketnode-gsmhrenc =               "3.10"
PREFERRED_VERSION_tisocketnode-gsmhrenc-codec =         "3.10"
PREFERRED_VERSION_tisocketnode-g711dec =		"3.10"
PREFERRED_VERSION_tisocketnode-g711dec-codec =		"3.10"
PREFERRED_VERSION_tisocketnode-nmu-plc-vad =            "3.10"
PREFERRED_VERSION_tisocketnode-g711enc =		"3.10"
PREFERRED_VERSION_tisocketnode-g711enc-codec =		"3.10"
PREFERRED_VERSION_tisocketnode-g722dec =		"3.10"
PREFERRED_VERSION_tisocketnode-g722dec-codec =		"3.10"
PREFERRED_VERSION_tisocketnode-g722enc =		"3.10"
PREFERRED_VERSION_tisocketnode-g722enc-codec =		"3.10"
PREFERRED_VERSION_tisocketnode-g723dec =		"3.10"
PREFERRED_VERSION_tisocketnode-g723dec-codec =		"3.10"
PREFERRED_VERSION_tisocketnode-g723enc =		"3.10"
PREFERRED_VERSION_tisocketnode-g723enc-codec =		"3.10"
PREFERRED_VERSION_tisocketnode-g726dec =		"3.10"
PREFERRED_VERSION_tisocketnode-g726dec-codec =		"3.10"
PREFERRED_VERSION_tisocketnode-g726enc =		"3.10"
PREFERRED_VERSION_tisocketnode-g726enc-codec =		"3.10"
PREFERRED_VERSION_tisocketnode-g729dec =		"3.10"
PREFERRED_VERSION_tisocketnode-g729dec-codec =		"3.10"
PREFERRED_VERSION_tisocketnode-g729enc =		"3.10"
PREFERRED_VERSION_tisocketnode-g729enc-codec =		"3.10"
PREFERRED_VERSION_tisocketnode-ilbcdec =		"3.10"
PREFERRED_VERSION_tisocketnode-ilbcdec-codec =		"3.10"
PREFERRED_VERSION_tisocketnode-ilbcenc =		"3.10"
PREFERRED_VERSION_tisocketnode-ilbcenc-codec =		"3.10"
#
PREFERRED_VERSION_tisocketnode-h264dec =                "3.10-P1"
PREFERRED_VERSION_tisocketnode-h264dec-codec =          "3.10"
PREFERRED_VERSION_tisocketnode-h264enc =                "3.10"
PREFERRED_VERSION_tisocketnode-h264enc-codec =          "3.10"
PREFERRED_VERSION_tisocketnode-mpeg4dec =               "3.10"
PREFERRED_VERSION_tisocketnode-mpeg4dec-codec =         "3.10"
PREFERRED_VERSION_tisocketnode-mpeg4enc =               "3.10"
PREFERRED_VERSION_tisocketnode-mpeg4enc-codec =         "3.10"
PREFERRED_VERSION_tisocketnode-mpeg4-720pdec =          "3.10"
PREFERRED_VERSION_tisocketnode-mpeg4-720pdec-codec =    "3.10"
PREFERRED_VERSION_tisocketnode-mpeg4-720penc =          "3.10"
PREFERRED_VERSION_tisocketnode-mpeg4-720penc-codec =    "3.10"
PREFERRED_VERSION_tisocketnode-mpeg4-xdm720pdec =          "3.10"
PREFERRED_VERSION_tisocketnode-mpeg4-xdm720pdec-codec =    "3.10"
PREFERRED_VERSION_tisocketnode-mpeg4-xdm720penc =          "3.10"
PREFERRED_VERSION_tisocketnode-mpeg4-xdm720penc-codec =    "3.10"
PREFERRED_VERSION_tisocketnode-wmv9 =                   "3.10-P1"
PREFERRED_VERSION_tisocketnode-wmv9-codec =             "3.10"
PREFERRED_VERSION_tisocketnode-spark =                  "3.10"
PREFERRED_VERSION_tisocketnode-spark-codec =            "3.10"
#
PREFERRED_VERSION_tisocketnode-jpegdec =                "3.10"
PREFERRED_VERSION_tisocketnode-jpegdec-codec =          "3.10"
PREFERRED_VERSION_tisocketnode-jpegenc =                "3.10"
PREFERRED_VERSION_tisocketnode-jpegenc-codec =          "3.10-P1"
PREFERRED_VERSION_tisocketnode-conversions =		"3.10"
# Ittiam
PREFERRED_VERSION_tisocketnode-h264decitt =		"20100208"
PREFERRED_VERSION_tisocketnode-h264decitt-codec =	"20100208"
PREFERRED_VERSION_tisocketnode-mpeg4decitt =		"20100208"
PREFERRED_VERSION_tisocketnode-mpeg4decitt-codec =	"20100208"

# openmax
PREFERRED_PROVIDER_virtual/openmax-il =		"meta-tiopenmax-modular"
#PREFERRED_PROVIDER_virtual/openmax-il =		"tiopenmax"
PREFERRED_VERSION_tiopenmax =			"3.28-P1"
PREFERRED_VERSION_tiopenmax-core =		"3.28-P1"
PREFERRED_VERSION_tiopenmax-clock =		"3.28-P1"
PREFERRED_VERSION_tiopenmax-perf =		"3.28-P1"
PREFERRED_VERSION_tiopenmax-lcml =		"3.28-P1"
PREFERRED_VERSION_tiopenmax-policymanager =	"3.28-P1"
PREFERRED_VERSION_tiopenmax-audiomanager =	"3.28-P1"
PREFERRED_VERSION_tiopenmax-resourcemanager =	"3.28-P1"
PREFERRED_VERSION_tiopenmax-jpegdec =		"3.28-P1"
PREFERRED_VERSION_tiopenmax-jpegenc =		"3.28-P1"
PREFERRED_VERSION_tiopenmax-aacdec =            "3.28-P1"
PREFERRED_VERSION_tiopenmax-aacenc =            "3.28-P1"
PREFERRED_VERSION_tiopenmax-armaacdec =         "3.28-P1"
PREFERRED_VERSION_tiopenmax-armaacenc =         "3.28-P1"
PREFERRED_VERSION_tiopenmax-camera =            "3.28-P1"
PREFERRED_VERSION_tiopenmax-common =            "3.28-P1"
PREFERRED_VERSION_tiopenmax-g711dec =           "3.28-P1"
PREFERRED_VERSION_tiopenmax-g711enc =           "3.28-P1"
PREFERRED_VERSION_tiopenmax-g722dec =           "3.28-P1"
PREFERRED_VERSION_tiopenmax-g722enc =           "3.28-P1"
PREFERRED_VERSION_tiopenmax-g723dec =           "3.28-P1"
PREFERRED_VERSION_tiopenmax-g723enc =           "3.28-P1"
PREFERRED_VERSION_tiopenmax-g726dec =           "3.28-P1"
PREFERRED_VERSION_tiopenmax-g726enc =           "3.28-P1"
PREFERRED_VERSION_tiopenmax-g729dec =           "3.28-P1"
PREFERRED_VERSION_tiopenmax-g729enc =           "3.28-P1"
PREFERRED_VERSION_tiopenmax-gsmfrdec =          "3.28-P1"
PREFERRED_VERSION_tiopenmax-gsmfrenc =          "3.28-P1"
PREFERRED_VERSION_tiopenmax-gsmhrdec =          "3.28-P1"
PREFERRED_VERSION_tiopenmax-gsmhrenc =          "3.28-P1"
PREFERRED_VERSION_tiopenmax-ilbcdec =           "3.28-P1"
PREFERRED_VERSION_tiopenmax-ilbcenc =           "3.28-P1"
PREFERRED_VERSION_tiopenmax-imaadpcmdec =       "3.28-P1"
PREFERRED_VERSION_tiopenmax-imaadpcmenc =       "3.28-P1"
PREFERRED_VERSION_tiopenmax-inst2 =		"3.28-P1"
PREFERRED_VERSION_tiopenmax-mp3 =               "3.28-P1"
PREFERRED_VERSION_tiopenmax-nbamrdec =          "3.28-P1"
PREFERRED_VERSION_tiopenmax-nbamrenc =          "3.28-P1"
PREFERRED_VERSION_tiopenmax-pcmdec =            "3.28-P1"
PREFERRED_VERSION_tiopenmax-pcmenc =            "3.28-P1"
PREFERRED_VERSION_tiopenmax-postproc =          "3.28-P1"
PREFERRED_VERSION_tiopenmax-prepostproc =	"3.28-P1"
PREFERRED_VERSION_tiopenmax-ram =               "3.28-P1"
PREFERRED_VERSION_tiopenmax-resourcemanager =   "3.28-P1"
PREFERRED_VERSION_tiopenmax-rmproxy =           "3.28-P1"
PREFERRED_VERSION_tiopenmax-videodec =          "3.28-P1"
PREFERRED_VERSION_tiopenmax-videoenc =          "3.28-P1"
PREFERRED_VERSION_tiopenmax-wbamrdec =          "3.28-P1"
PREFERRED_VERSION_tiopenmax-wbamrenc =          "3.28-P1"
PREFERRED_VERSION_tiopenmax-wmadec =            "3.28-P1"
PREFERRED_VERSION_tiopenmax-cspec = 		"3.28-P1"
PREFERRED_VERSION_tiopenmax-avrecordtest =	"3.28-P1"
PREFERRED_VERSION_tiopenmax-avplaytest =	"3.28-P1"
PREFERRED_VERSION_tiopenmax-imagecapturetest =	"3.28-P1"
PREFERRED_VERSION_tiopenmax-imagedisplaytest =	"3.28-P1"
PREFERRED_VERSION_tiopenmax-videodisplaytest =	"3.28-P1"
PREFERRED_VERSION_tiopenmax-videocapturetest =	"3.28-P1"
PREFERRED_VERSION_mm-isp =			"1.17"
# Ittiam
PREFERRED_VERSION_tiopenmax-videodecitt = 	"3.28-P1"
#PREFERRED_VERSION_tiopenmax-aacdecitt = 	"20100114"

# gstreamer
PREFERRED_VERSION_libgoo =		"5.i3.3"
PREFERRED_VERSION_gst-goo =		"5.i3.3"
PREFERRED_VERSION_gst-pyapps =		"5.I3.2"

# connectivity
SRCREV_pn-wilink = "69e18d76b8e34eac40e51ca0911cbb29efba495e"
PREFERRED_VERSION_wilink-firmware =    "1.1"
PREFERRED_VERSION_btfm = 		"23.I3.3"
PREFERRED_VERSION_fmapp =              "23.I3.3"
PREFERRED_VERSION_kfmapp = 		"23.I3.4"
PREFERRED_VERSION_gps-navilink =	"23.17.0"

# graphics
PREFERRED_VERSION_sgx-kernel-module =	"1.4.1.2"
PREFFERED_VERSION_sgx-lib-noxws =	"1.4.1.2"

# open source dependencies
PREFERRED_VERSION_gst-plugins-bad =	"git"
PREFERRED_VERSION_gst-plugins-ugly =	"git"
PREFERRED_VERSION_gst-plugins-good =	"git"
PREFERRED_VERSION_gst-plugins-base =	"git"
PREFERRED_VERSION_gstreamer = 		"git"
PREFERRED_VERSION_gst-qtmux =		"svn"
PREFERRED_VERSION_check =		"0.9.5"
PREFERRED_VERSION_amrnb =		"7.0.0.2"
PREFERRED_VERSION_amrwb =		"7.0.0.1"
PREFERRED_VERSION_fuse =		"2.7.4"
PREFERRED_VERSION_openobex =		"0.22"
PREFERRED_VERSION_obexfs =		"0.12"
PREFERRED_VERSION_obexftp =		"0.22"
PREFERRED_VERSION_bison =		"2.3"
PREFERRED_VERSION_bison-native =	"2.3"
PREFERRED_VERSION_flex =		"2.5.35"
PREFERRED_VERSION_flex-native =		"2.5.35"
PREFERRED_VERSION_iperf =		"2.0.4"
PREFERRED_VERSION_libmms =		"0.4"

# toolchain
PREFERRED_VERSION_external-csl-toolchain =	"2008q3-72"

# test
PREFERRED_VERSION_cheese	=	"2.24.3"
PREFERRED_VERSION_intltool	=	"0.40.0"

# extra (will be replaced by pokyomap in subsequent releases)
PREFERRED_VERSION_gtk+		=	"2.14.7"
PREFERRED_VERSION_glib-2.0	=	"2.18.4"
PREFERRED_VERSION_pango		=	"1.22.4"
PREFERRED_VERSION_cairo		=	"1.8.6"
PREFERRED_VERSION_pixman	=	"0.14.0"
```
