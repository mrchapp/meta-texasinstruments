## conf/distro/include/versions-23.17M.inc
```bitbake
# tasks and images
PREFERRED_VERSION_task-omap-bridge.bb =			"1.0"
PREFERRED_VERSION_task-omap-connectivity.bb =		"1.0"
PREFERRED_VERSION_task-omap-gfx.bb =			"1.0"
PREFERRED_VERSION_task-omap-gst.bb =			"1.0"
PREFERRED_VERSION_task-omap-omx.bb =			"1.0"
PREFERRED_VERSION_task-omap-sn.bb =			"1.0"
PREFERRED_VERSION_task-omap-test.bb =			"1.0"
PREFERRED_VERSION_omap-image-minimal-mtdutils.bb =	"1.0"
PREFERRED_VERSION_omap-image-minimal.bb =		"1.0"
PREFERRED_VERSION_omap-image-mm.bb =			"1.0"
PREFERRED_VERSION_omap-image-sato.bb =			"1.0

# baseport
PREFERRED_VERSION_x-load =				"23.17M"
PREFERRED_VERSION_u-boot =				"23.17M"
PREFERRED_VERSION_linux-tiomap =			"2.6.24.7-23.17M"

# bridge and friends
PREFERRED_VERSION_tidspbridge-module =			"23.17M"
PREFERRED_VERSION_tidspbridge-lib =			"23.17M"
PREFERRED_VERSION_tidspbridge-samples =			"23.17M"
PREFERRED_VERSION_tidspbridge-extra =			"23.17M"
PREFERRED_VERSION_tidspbridge-cgt6x =			"6.0.7"
PREFERRED_VERSION_tidspbridge-bios =			"5.33.02"
PREFERRED_VERSION_tidspbridge-dllcreate-native =	"23.17M"

# baseimage
PREFERRED_VERSION_baseimage-masterconfig =		"23.x"
PREFERRED_VERSION_baseimage-samplerateconverter =	"23.17M"
PREFERRED_VERSION_baseimage-dasf =			"23.17M"
PREFERRED_VERSION_baseimage-hal =			"23.17M"
PREFERRED_VERSION_baseimage-tmon =			"23.17M"
PREFERRED_VERSION_baseimage =				"23.17M"
PREFERRED_VERSION_baseimage-utils =			"23.17M"
PREFERRED_VERSION_baseimage-make-system =		"23.17M"
PREFERRED_VERSION_baseimage-avsync =			"23.17M"
PREFERRED_VERSION_baseimage-inst2 =			"23.17M"
PREFERRED_VERSION_baseimage-dasf-cspec =		"23.17M"
PREFERRED_VERSION_baseimage-system-cspec =		"23.17M"
PREFERRED_VERSION_baseimage-vgpop =			"23.17M"

# socket nodes and codecs
PREFERRED_VERSION_tisocketnode-cs =                     "23.17M"
PREFERRED_VERSION_tisocketnode-algo =			"23.17M"
PREFERRED_VERSION_tisocketnode-dfgm =			"23.17M"
PREFERRED_VERSION_tisocketnode-usn =			"23.17M"
PREFERRED_VERSION_tisocketnode-control-task =		"3.40"
PREFERRED_VERSION_tisocketnode-vpp =			"23.17M"
PREFERRED_VERSION_tisocketnode-ringio =			"23.17M"
PREFERRED_VERSION_tisocketnode-ipp =			"23.17M"
PREFERRED_VERSION_tisocketnode-mp3 =			"23.17M"
PREFERRED_VERSION_tisocketnode-mp3-codec =		"23.17M"
PREFERRED_VERSION_tisocketnode-mpeg4aacdec =		"23.17M"
PREFERRED_VERSION_tisocketnode-mpeg4aacdec-codec =	"23.17M"
PREFERRED_VERSION_tisocketnode-mpeg4aacenc =		"23.17M"
PREFERRED_VERSION_tisocketnode-mpeg4aacenc-codec =	"23.17M"
PREFERRED_VERSION_tisocketnode-wma9 =			"23.17M"
PREFERRED_VERSION_tisocketnode-wma9-codec =		"23.17M"
PREFERRED_VERSION_tisocketnode-pcmdec =			"23.17M"
PREFERRED_VERSION_tisocketnode-pcmenc =			"23.17M"
PREFERRED_VERSION_tisocketnode-ima-adpcmdec =		"23.17M"
PREFERRED_VERSION_tisocketnode-ima-adpcmdec-codec =	"23.17M"
PREFERRED_VERSION_tisocketnode-ima-adpcmenc =		"23.17M"
PREFERRED_VERSION_tisocketnode-ima-adpcmenc-codec =	"23.17M"
PREFERRED_VERSION_tisocketnode-nbamrdec =		"23.17M"
PREFERRED_VERSION_tisocketnode-nbamrdec-codec =		"23.17M"
PREFERRED_VERSION_tisocketnode-nbamrenc =		"23.17M"
PREFERRED_VERSION_tisocketnode-nbamrenc-codec =		"23.17M"
PREFERRED_VERSION_tisocketnode-wbamrdec =		"23.17M"
PREFERRED_VERSION_tisocketnode-wbamrdec-codec =		"23.17M"
PREFERRED_VERSION_tisocketnode-wbamrenc =		"23.17M"
PREFERRED_VERSION_tisocketnode-wbamrenc-codec =		"23.17M"
PREFERRED_VERSION_tisocketnode-gsmfrdec =		"23.17M"
PREFERRED_VERSION_tisocketnode-gsmfrdec-codec =		"23.17M"
PREFERRED_VERSION_tisocketnode-gsmfrenc =		"23.17M"
PREFERRED_VERSION_tisocketnode-gsmfrenc-codec =		"23.17M"
PREFERRED_VERSION_tisocketnode-gsmhrdec =		"23.17M"
PREFERRED_VERSION_tisocketnode-gsmhrdec-codec =		"23.17M"
PREFERRED_VERSION_tisocketnode-gsmhrenc =		"23.17M"
PREFERRED_VERSION_tisocketnode-gsmhrenc-codec =		"23.17M"
PREFERRED_VERSION_tisocketnode-g711dec =		"23.17M"
PREFERRED_VERSION_tisocketnode-g711dec-codec =		"23.17M"
PREFERRED_VERSION_tisocketnode-nmu-plc-vad =		"23.17M"
PREFERRED_VERSION_tisocketnode-g711enc =		"23.17M"
PREFERRED_VERSION_tisocketnode-g711enc-codec =		"23.17M"
PREFERRED_VERSION_tisocketnode-g722dec =		"23.17M"
PREFERRED_VERSION_tisocketnode-g722dec-codec =		"23.17M"
PREFERRED_VERSION_tisocketnode-g722enc =		"23.17M"
PREFERRED_VERSION_tisocketnode-g722enc-codec =		"23.17M"
PREFERRED_VERSION_tisocketnode-g723dec =		"23.17M"
PREFERRED_VERSION_tisocketnode-g723dec-codec =		"23.17M"
PREFERRED_VERSION_tisocketnode-g723enc =		"23.17M"
PREFERRED_VERSION_tisocketnode-g723enc-codec =		"23.17M"
PREFERRED_VERSION_tisocketnode-g726dec =		"23.17M"
PREFERRED_VERSION_tisocketnode-g726dec-codec =		"23.17M"
PREFERRED_VERSION_tisocketnode-g726enc =		"23.17M"
PREFERRED_VERSION_tisocketnode-g726enc-codec =		"23.17M"
PREFERRED_VERSION_tisocketnode-g729dec =		"23.17M"
PREFERRED_VERSION_tisocketnode-g729dec-codec =		"23.17M"
PREFERRED_VERSION_tisocketnode-g729enc =		"23.17M"
PREFERRED_VERSION_tisocketnode-g729enc-codec =		"23.17M"
PREFERRED_VERSION_tisocketnode-ilbcdec =		"23.17M"
PREFERRED_VERSION_tisocketnode-ilbcdec-codec =		"23.17M"
PREFERRED_VERSION_tisocketnode-ilbcenc =		"23.17M"
PREFERRED_VERSION_tisocketnode-ilbcenc-codec =		"23.17M"
PREFERRED_VERSION_tisocketnode-h264dec =		"23.17M"
PREFERRED_VERSION_tisocketnode-h264dec-codec =		"23.17M"
PREFERRED_VERSION_tisocketnode-h264enc =		"23.17M"
PREFERRED_VERSION_tisocketnode-h264enc-codec =		"23.17M"
PREFERRED_VERSION_tisocketnode-mpeg4dec =		"23.17M"
PREFERRED_VERSION_tisocketnode-mpeg4dec-codec =		"23.17M"
PREFERRED_VERSION_tisocketnode-mpeg4enc =		"23.17M"
PREFERRED_VERSION_tisocketnode-mpeg4enc-codec =		"23.17M"
PREFERRED_VERSION_tisocketnode-mpeg4-720pdec =		"23.17M"
PREFERRED_VERSION_tisocketnode-mpeg4-720pdec-codec =	"23.17M"
PREFERRED_VERSION_tisocketnode-mpeg4-720penc =		"23.17M"
PREFERRED_VERSION_tisocketnode-mpeg4-720penc-codec =	"23.17M"
PREFERRED_VERSION_tisocketnode-mpeg4-xdm720pdec =	"23.17M"
PREFERRED_VERSION_tisocketnode-mpeg4-xdm720pdec-codec =	"23.17M"
PREFERRED_VERSION_tisocketnode-mpeg4-xdm720penc =	"23.17M"
PREFERRED_VERSION_tisocketnode-mpeg4-xdm720penc-codec =	"23.17M"
PREFERRED_VERSION_tisocketnode-mpeg2 =			"23.17M"
PREFERRED_VERSION_tisocketnode-mpeg2-codec =		"23.17M"
PREFERRED_VERSION_tisocketnode-wmv9 =			"23.17M"
PREFERRED_VERSION_tisocketnode-wmv9-codec =		"23.17M"
#PREFERRED_VERSION_tisocketnode-mpeg2 =			"23.17M"
#PREFERRED_VERSION_tisocketnode-mpeg2-codec =		"23.17M"
PREFERRED_VERSION_tisocketnode-spark =			"23.17M"
PREFERRED_VERSION_tisocketnode-spark-codec =		"23.17M"
PREFERRED_VERSION_tisocketnode-jpegdec =		"23.17M"
PREFERRED_VERSION_tisocketnode-jpegdec-codec =		"23.17M"
PREFERRED_VERSION_tisocketnode-jpegenc =		"23.17M"
PREFERRED_VERSION_tisocketnode-jpegenc-codec =		"23.17M"
PREFERRED_VERSION_tisocketnode-conversions =		"23.17M"
# openmax
PREFERRED_PROVIDER_virtual/openmax-il =			"meta-tiopenmax-modular"
#PREFERRED_PROVIDER_virtual/openmax-il =		"tiopenmax"
PREFERRED_VERSION_tiopenmax =				"23.17M"
PREFERRED_VERSION_tiopenmax-core =			"23.17M"
PREFERRED_VERSION_tiopenmax-clock =			"23.17M"
PREFERRED_VERSION_tiopenmax-perf =			"23.17M"
PREFERRED_VERSION_tiopenmax-lcml =			"23.17M"
PREFERRED_VERSION_tiopenmax-policymanager =		"23.17M"
PREFERRED_VERSION_tiopenmax-audiomanager =		"23.17M"
PREFERRED_VERSION_tiopenmax-resourcemanager =		"23.17M"
PREFERRED_VERSION_tiopenmax-jpegdec =			"23.17M"
PREFERRED_VERSION_tiopenmax-jpegenc =			"23.17M"
PREFERRED_VERSION_tiopenmax-aacdec =			"23.17M"
PREFERRED_VERSION_tiopenmax-aacenc =			"23.17M"
PREFERRED_VERSION_tiopenmax-armaacdec =			"23.17M"
PREFERRED_VERSION_tiopenmax-armaacenc =			"23.17M"
PREFERRED_VERSION_tiopenmax-camera =            	"23.17M"
PREFERRED_VERSION_tiopenmax-common =            	"23.17M"
PREFERRED_VERSION_tiopenmax-g711dec =           	"23.17M"
PREFERRED_VERSION_tiopenmax-g711enc =           	"23.17M"
PREFERRED_VERSION_tiopenmax-g722dec =           	"23.17M"
PREFERRED_VERSION_tiopenmax-g722enc =           	"23.17M"
PREFERRED_VERSION_tiopenmax-g723dec =           	"23.17M"
PREFERRED_VERSION_tiopenmax-g723enc =           	"23.17M"
PREFERRED_VERSION_tiopenmax-g726dec =			"23.17M"
PREFERRED_VERSION_tiopenmax-g726enc =			"23.17M"
PREFERRED_VERSION_tiopenmax-g729dec =			"23.17M"
PREFERRED_VERSION_tiopenmax-g729enc =			"23.17M"
PREFERRED_VERSION_tiopenmax-gsmfrdec =			"23.17M"
PREFERRED_VERSION_tiopenmax-gsmfrenc =			"23.17M"
PREFERRED_VERSION_tiopenmax-gsmhrdec =			"23.17M"
PREFERRED_VERSION_tiopenmax-gsmhrenc =			"23.17M"
PREFERRED_VERSION_tiopenmax-ilbcdec =			"23.17M"
PREFERRED_VERSION_tiopenmax-ilbcenc =			"23.17M"
PREFERRED_VERSION_tiopenmax-imaadpcmdec =		"23.17M"
PREFERRED_VERSION_tiopenmax-imaadpcmenc =		"23.17M"
PREFERRED_VERSION_tiopenmax-inst2 =			"23.17M"
PREFERRED_VERSION_tiopenmax-mp3 =			"23.17M"
PREFERRED_VERSION_tiopenmax-nbamrdec =			"23.17M"
PREFERRED_VERSION_tiopenmax-nbamrenc =			"23.17M"
PREFERRED_VERSION_tiopenmax-pcmdec =			"23.17M"
PREFERRED_VERSION_tiopenmax-pcmenc =			"23.17M"
PREFERRED_VERSION_tiopenmax-postproc =			"23.17M"
PREFERRED_VERSION_tiopenmax-prepostproc =		"23.17M"
PREFERRED_VERSION_tiopenmax-ram =			"23.17M"
PREFERRED_VERSION_tiopenmax-rmproxy =			"23.17M"
PREFERRED_VERSION_tiopenmax-videodec =			"23.17M"
PREFERRED_VERSION_tiopenmax-videoenc =			"23.17M"
PREFERRED_VERSION_tiopenmax-wbamrdec =			"23.17M"
PREFERRED_VERSION_tiopenmax-wbamrenc =			"23.17M"
PREFERRED_VERSION_tiopenmax-wmadec =			"23.17M"
PREFERRED_VERSION_tiopenmax-cspec =			"23.17M"
PREFERRED_VERSION_tiopenmax-avrecordtest =		"23.17M"
PREFERRED_VERSION_tiopenmax-avplaytest =		"23.17M"
PREFERRED_VERSION_tiopenmax-imagecapturetest =		"23.17M"
PREFERRED_VERSION_tiopenmax-imagedisplaytest =		"23.17M"
PREFERRED_VERSION_tiopenmax-videodisplaytest =		"23.17M"
PREFERRED_VERSION_tiopenmax-videocapturetest =		"23.17M"
PREFERRED_VERSION_mm-isp =				"23.17M"

# gstreamer
PREFERRED_VERSION_libgoo =				"5.17m.3"
PREFERRED_VERSION_gst-goo =				"5.17m.3"
PREFERRED_VERSION_gst-pyapps =				"23.17M"

# connectivity
PREFERRED_VERSION_wilink =				"23.17M"
PREFERRED_VERSION_btfm =				"23.17M"
PREFERRED_VERSION_fmapp =				"23.17M"
PREFERRED_VERSION_gps-navilink =			"23.17M"

# graphics
PREFERRED_VERSION_sgx-kernel-module =			"23.17M"
PREFFERED_VERSION_sgx-lib-noxws =			"23.17M"

# open source dependencies
PREFERRED_VERSION_gst-plugins-bad =			"git"
PREFERRED_VERSION_gst-plugins-ugly =			"git"
PREFERRED_VERSION_gst-plugins-good =			"git"
PREFERRED_VERSION_gst-plugins-base =			"git"
PREFERRED_VERSION_gstreamer =				"git"
PREFERRED_VERSION_gst-qtmux =				"svn"
PREFERRED_VERSION_check =				"0.9.5"
PREFERRED_VERSION_amrnb =				"7.0.0.2"
PREFERRED_VERSION_amrwb =				"7.0.0.1"
#PREFERRED_VERSION_openobex =				"0.22"
PREFERRED_VERSION_bison-1.875 =				"1.875"
PREFERRED_VERSION_bison-native-1.875 =			"1.875"
PREFERRED_VERSION_flex =				"2.5.35"
PREFERRED_VERSION_flex-native =				"2.5.35"
PREFERRED_VERSION_iperf =				"2.0.4"
PREFERRED_VERSION_libmms =				"0.3"

# toolchain
PREFERRED_VERSION_external-csl-toolchain =		"2008q3-72"

# test
PREFERRED_VERSION_cheese =				"2.24.3"
PREFERRED_VERSION_intltool =				"0.40.0"

# extra (will be replaced by pokyomap in subsequent releases)
PREFERRED_VERSION_gtk+ =				"2.14.7"
PREFERRED_VERSION_glib-2.0 =				"2.18.4"
PREFERRED_VERSION_pango =				"1.22.4"
PREFERRED_VERSION_cairo =				"1.8.6"
PREFERRED_VERSION_pixman =				"0.14.0"
#
```

## conf/distro/include/versions-23.I3.1_omap-3430sdp.inc
```bitbake
# omap3430 SDP specific versions

# baseport
PREFERRED_VERSION_x-load =             "4.63"
PREFERRED_VERSION_u-boot =             "5.11"
```

## conf/distro/include/versions-23.I3.1_omap-3630sdp.inc
```bitbake
# omap3630 SDP specific versions

# baseport
SRCREV_pn-x-load ?= "e160c3806808a27e999f5c9400e77ce45bb87bc2"
SRCREV_pn-u-boot ?= "b6d88026e21a307d154cc88dacb8cea48fdd96ee"
```

## conf/distro/include/versions-23.I3.1_zoom2.inc
```bitbake
# Zoom2 specific versions

# baseport
SRCREV_pn-x-load ?= "8422b561fbd750ccb852f89904bbb9c39e2fac7a"
SRCREV_pn-u-boot ?= "4edcb22171155ccf615d4b9ee4800606651dc623"
```

## conf/distro/include/versions-23.I3.1_zoom3.inc
```bitbake
# omap3630 zoom3 specific versions

# baseport
SRCREV_pn-x-load ?= "44091bc1ddec7fc712c492f9e6b36cf4d72e8120"
SRCREV_pn-u-boot ?= "37f49799630bca55849ba187eebcfd78fd8efbc3"
```

## conf/distro/include/versions-23.I3.2_omap-3630sdp.inc
```bitbake
# omap3630 SDP specific versions

# baseport
SRCREV_pn-x-load ?= "630f563dd5777be51049f3eae9322b96c618a023"
SRCREV_pn-u-boot ?= "9c58aa0ebbe49373c12c94d98093122c56a2e6bb"
```

## conf/distro/include/versions-23.I3.2_zoom3.inc
```bitbake
# omap3630 zoom3 specific versions

# baseport
SRCREV_pn-x-load ?= "cac29bbbaa2b57b4062e7e0bde711d993ea8eac0"
SRCREV_pn-u-boot ?= "2c5c4b4c5b44e697147be0d54fe49a12d5680dc1"
```
